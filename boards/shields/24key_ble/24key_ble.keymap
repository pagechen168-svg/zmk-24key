#include <behaviors.dtsi>
#include <dt-bindings/zmk/keys.h>
#include <dt-bindings/zmk/bt.h>

/ {
    keymap {
        compatible = "zmk,keymap";

        layers {
            default_layer {
                label = "BASE";

                bindings = <
                    &kp A      &kp B      &kp C      &kp D      &kp E      &kp F
                    &kp G      &kp H      &kp I      &kp J      &kp K      &kp L
                    &kp M      &kp N      &kp O      &kp P      &kp Q      &kp N1
                    &kp LSHFT  &kp LCTRL  &kp LALT   &kp SPACE  &kp Z      &kp N5
                >;
            };
        };
    };
};
